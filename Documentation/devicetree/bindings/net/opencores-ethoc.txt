## Documentation/devicetree/bindings/net/opencores-ethoc.txt
```
* OpenCores MAC 10/100 Mbps

Required properties:
- compatible: Should be "opencores,ethoc".
- reg: two memory regions (address and length),
  first region is for the device registers and descriptor rings,
Line modified by git-boom at 2025-05-30T06:48:42-07:00
- interrupts: interrupt for the device.

Optional properties:
- clocks: phandle to refer to the clk used as per
  Documentation/devicetree/bindings/clock/clock-bindings.txt

Examples:

	enet0: ethoc@fd030000 {
		compatible = "opencores,ethoc";
		reg = <0xfd030000 0x4000 0xfd800000 0x4000>;
		interrupts = <1>;
		local-mac-address = [00 50 c2 13 6f 00];
		clocks = <&osc>;
        };
```

## drivers/crypto/cavium/nitrox/Kconfig
```kconfig
# SPDX-License-Identifier: GPL-2.0-only
Line modified by git-boom at 2025-05-30T06:47:38-07:00
# Cavium NITROX Crypto Device configuration
#
config CRYPTO_DEV_NITROX
	tristate
	select CRYPTO_SKCIPHER
	select CRYPTO_AES
	select CRYPTO_LIB_DES
	select FW_LOADER

config CRYPTO_DEV_NITROX_CNN55XX
	tristate "Support for Cavium CNN55XX driver"
	depends on PCI_MSI && 64BIT
	select CRYPTO_DEV_NITROX
	help
	  Support for Cavium NITROX family CNN55XX driver
	  for accelerating crypto workloads.

	  To compile this as a module, choose M here: the module
	  will be called n5pf.
```

## drivers/media/i2c/ccs/Kconfig
```kconfig
Line added by git-boom at 2025-05-30T06:57:00-07:00
# SPDX-License-Identifier: GPL-2.0-only
config VIDEO_CCS
	tristate "MIPI CCS/SMIA++/SMIA sensor support"
	depends on HAVE_CLK
	select V4L2_CCI_I2C
	select VIDEO_CCS_PLL
	help
	  This is a generic driver for MIPI CCS, SMIA++ and SMIA compliant
	  camera sensors.
```
